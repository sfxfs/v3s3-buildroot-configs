## Config.in
```kconfig
config BR2_EXTERNAL_ENABLE_INITRAMFS
	bool "Include pre-built initramfs image"
	default n
	help
		Enable the inclusion of an initramfs image in the rootfs. The initramfs
		image is built via 'make licheepi_zero_initramfs_defconfig'. For more
		information, see the Github repo.
```
