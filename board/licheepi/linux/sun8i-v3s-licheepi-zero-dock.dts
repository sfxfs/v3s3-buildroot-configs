
#include "sun8i-v3s-licheepi-zero.dts"
#include <dt-bindings/input/input.h>

/ {
	model = "Lichee Pi Zero with Dock";
	compatible = "licheepi,licheepi-zero-dock", "licheepi,licheepi-zero",
		     "allwinner,sun8i-v3s";
	aliases {
		ethernet0 = &emac;
	};

	leds {
		// note: LED pins conflict with MMC1, so only 1 can be used
		status = "okay";
	};
};

&emac {
	phy-handle = <&int_mii_phy>;
	phy-mode = "mii";
	allwinner,leds-active-low;
	status = "okay";
};
